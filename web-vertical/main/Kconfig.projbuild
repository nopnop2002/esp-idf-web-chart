## web-vertical/main/Kconfig.projbuild
```kconfig
menu "Application configuration"

	menu "WiFi Setting"

		config ESP_WIFI_SSID
			string "WiFi SSID"
			default "myssid"
			help
				SSID (network name) to connect to.

		config ESP_WIFI_PASSWORD
			string "WiFi Password"
			default "mypassword"
			help
				WiFi password (WPA or WPA2) to connect to.

		config ESP_MAXIMUM_RETRY
			int "Maximum retry"
			default 5
			help
				Set the Maximum retry to avoid station reconnecting to the AP unlimited when the AP is really inexistent.

		config MDNS_HOSTNAME
			string "mDNS Hostname"
			default "esp32-server"
			help
				The mDNS host name used by the ESP32.

	endmenu

	menu "ADC Setting"

		config GPIO_RANGE_MIN
				int
				default 32 if IDF_TARGET_ESP32
				default  1 if IDF_TARGET_ESP32S2
				default  1 if IDF_TARGET_ESP32S3
				default  0 if IDF_TARGET_ESP32C3

		config GPIO_RANGE_MAX
				int
				default 39 if IDF_TARGET_ESP32
				default 10 if IDF_TARGET_ESP32S2
				default 10 if IDF_TARGET_ESP32S3
				default  4 if IDF_TARGET_ESP32C3

		config METER1_GPIO
			int "GPIO for ADC1"
			range GPIO_RANGE_MIN GPIO_RANGE_MAX
			default 32 if IDF_TARGET_ESP32
			default  1 if IDF_TARGET_ESP32S2
			default  1 if IDF_TARGET_ESP32S3
			default  0 if IDF_TARGET_ESP32C3
			help
				ADC1_CHANNEL number.
				Some GPIOs are used for other purposes (flash connections, etc.) and cannot be used to ADC.
				On the ESP32, 8 channels: GPIO32 - GPIO39.
				On the ESP32-S2, 10 channels: GPIO1 - GPIO10.
				On the ESP32-S3, 10 channels: GPIO1 - GPIO10.
				On the ESP32-C3, 5 channels: GPIO0 - GPIO4.

		config ENABLE_METER2
			bool "Enable METER2"
			default n
			help
				Enable Meter2.

		config METER2_GPIO
			depends on ENABLE_METER2
			int "GPIO for METER2"
			range GPIO_RANGE_MIN GPIO_RANGE_MAX
			default 33 if IDF_TARGET_ESP32
			default  2 if IDF_TARGET_ESP32S2
			default  2 if IDF_TARGET_ESP32S3
			default  1 if IDF_TARGET_ESP32C3
			help
				ADC1_CHANNEL number.
				Some GPIOs are used for other purposes (flash connections, etc.) and cannot be used to ADC.
				On the ESP32, 8 channels: GPIO32 - GPIO39.
				On the ESP32-S2, 10 channels: GPIO1 - GPIO10.
				On the ESP32-S3, 10 channels: GPIO1 - GPIO10.
				On the ESP32-C3, 5 channels: GPIO0 - GPIO4.

		config ENABLE_METER3
			bool "Enable METER3"
			default n
			help
				Enable Meter3.

		config METER3_GPIO
			depends on ENABLE_METER3
			int "GPIO for METER3"
			range GPIO_RANGE_MIN GPIO_RANGE_MAX
			default 34 if IDF_TARGET_ESP32
			default  3 if IDF_TARGET_ESP32S2
			default  3 if IDF_TARGET_ESP32S3
			default  2 if IDF_TARGET_ESP32C3
			help
				ADC1_CHANNEL number.
				Some GPIOs are used for other purposes (flash connections, etc.) and cannot be used to ADC.
				On the ESP32, 8 channels: GPIO32 - GPIO39.
				On the ESP32-S2, 10 channels: GPIO1 - GPIO10.
				On the ESP32-S3, 10 channels: GPIO1 - GPIO10.
				On the ESP32-C3, 5 channels: GPIO0 - GPIO4.
	
		config ADC_CYCLE
			int "ADC measurement cycle tick"
			range 100 1000
			default 100
			help
				ADC measurement cycle tick.

		config ENABLE_STDOUT
			bool "Enable STDOUT"
			default n
			help
				Enable STDOUT.

	endmenu

endmenu
```
